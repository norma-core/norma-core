## device-support/arduino-portenta-x8/yocto/meta-normacore-x8/conf/layer.conf
```bitbake
BBPATH .= ":${LAYERDIR}"

BBFILES += "${LAYERDIR}/recipes-*/*/*.bb \
            ${LAYERDIR}/recipes-*/*/*.bbappend"

BBFILE_COLLECTIONS += "normacore-x8"
BBFILE_PATTERN_normacore-x8 = "^${LAYERDIR}/"
BBFILE_PRIORITY_normacore-x8 = "99"

LAYERDEPENDS_normacore-x8 = "core openembedded-layer meta-arduino-nxp meta-tailscale"
LAYERSERIES_COMPAT_normacore-x8 = "scarthgap"
```
